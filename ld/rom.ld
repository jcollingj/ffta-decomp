OUTPUT_ARCH(arm)
ENTRY(_start)

SECTIONS
{
    gUnitPoolA = 0x02002FC4;
    gUnitPoolB = 0x02000080;
    gContentRecords = 0x0854CD54;
    gContentState = 0x020020D0;
    gInventoryEntries = 0x02001940;
    gClearMemory = 0x0836D4B8;
    gSaveData = 0x02000000;
    gJobs = 0x08521A14;
    gGameFlags = 0x02001F70;
    gAbilityLists = 0x0851BA84;
    gContentPointers = 0x08526680;
    gUnitRecords14 = 0x085273D8;
    gRecordCopyBuffer = 0x03003A60;
    gCopyRecordMemory = 0x0836D4BC;
    gRecordSources0 = 0x0841A560;
    gRecordSources1 = 0x0841BB40;
    gRecordSources2 = 0x0841B060;
    gAmountRecords10 = 0x08527E62;
    gItemAdjustment2 = 0x08528A44;
    gItemAdjustment3 = 0x08528AA4;
    gItemAdjustment4 = 0x08528B04;
    gItemAdjustment5 = 0x08528B64;
    gItemAdjustment6 = 0x08528BC4;
    gClassRecords4 = 0x0839475C;
    gClassRecords16 = 0x08528F34;
    gCollectionBytes = 0x02002E64;
    gCollectionHalfwords = 0x02001F3C;
    gMappedJobs = 0x08394778;
    gRandomState = 0x030034B0;
    gRandomItemSlots = 0x02001F30;
    gRecords70 = 0x0855AE4C;
    gAbilities = 0x0855187C;
    . = 0x08000000;
    .text : {
        *(.text)
    }
    ASSERT(ReadUnitField == 0x80c7ea4, "ReadUnitField moved")
    ASSERT(UnitField01AboveOne == 0x80c817c, "UnitField01AboveOne moved")
    ASSERT(UnitField01Equals == 0x80c8194, "UnitField01Equals moved")
    ASSERT(UnitField03Equals1 == 0x80c81b0, "UnitField03Equals1 moved")
    ASSERT(UnitField03Equals2 == 0x80c81c8, "UnitField03Equals2 moved")
    ASSERT(UnitField03Equals3 == 0x80c81e0, "UnitField03Equals3 moved")
    ASSERT(UnitField03Equals4 == 0x80c81f8, "UnitField03Equals4 moved")
    ASSERT(UnitField03Equals5 == 0x80c8210, "UnitField03Equals5 moved")
    ASSERT(UnitField04Equals24 == 0x80c8228, "UnitField04Equals24 moved")
    ASSERT(UnitField27HasBit15 == 0x80c8240, "UnitField27HasBit15 moved")
    ASSERT(UnitField27HasBit13 == 0x80c8260, "UnitField27HasBit13 moved")
    ASSERT(UnitField19IsZero == 0x80c8280, "UnitField19IsZero moved")
    ASSERT(UnitField27HasBit12 == 0x80c8298, "UnitField27HasBit12 moved")
    ASSERT(UnitField27HasBit14 == 0x80c82b8, "UnitField27HasBit14 moved")
    ASSERT(UnitField27HasBit3 == 0x80c82d8, "UnitField27HasBit3 moved")
    ASSERT(UnitField27HasBit4 == 0x80c82f4, "UnitField27HasBit4 moved")
    ASSERT(UnitField27HasBit2 == 0x80c8310, "UnitField27HasBit2 moved")
    ASSERT(UnitField27HasBit6 == 0x80c832c, "UnitField27HasBit6 moved")
    ASSERT(UnitField27HasBit5 == 0x80c8348, "UnitField27HasBit5 moved")
    ASSERT(UnitField27HasBit8 == 0x80c8364, "UnitField27HasBit8 moved")
    ASSERT(UnitField03InRange6To18 == 0x80c8384, "UnitField03InRange6To18 moved")
    ASSERT(ReadContentValue0 == 0x80c84f4, "ReadContentValue0 moved")
    ASSERT(ReadContentValue1 == 0x80c8530, "ReadContentValue1 moved")
    ASSERT(GetJobProperty == 0x080C8570, "GetJobProperty moved")
    ASSERT(GetUnitProperty == 0x080C92F0, "GetUnitProperty moved")
    ASSERT(GetUnitNameStringId == 0x080C9314, "GetUnitNameStringId moved")
    ASSERT(ApplyUnitJobWithFlag == 0x80c93c8, "ApplyUnitJobWithFlag moved")
    ASSERT(EnableFixedJobFlags == 0x80c9340, "EnableFixedJobFlags moved")
    ASSERT(FindJobForAbilityRange == 0x80c94d0, "FindJobForAbilityRange moved")
    ASSERT(FindJobMappingKey == 0x80c9400, "FindJobMappingKey moved")
    ASSERT(ReadJobMappingValue == 0x80c93f0, "ReadJobMappingValue moved")
    ASSERT(ReadMappedClassValue == 0x80c9460, "ReadMappedClassValue moved")
    ASSERT(ReadUnitJobRelatedValue == 0x80c9428, "ReadUnitJobRelatedValue moved")
    ASSERT(gJobRequirements == 0x085231A4, "gJobRequirements moved")
    ASSERT(gJobMapping == 0x085231F4, "gJobMapping moved")
    ASSERT(GetGameFlag == 0x080C9540, "GetGameFlag moved")
    ASSERT(SetGameFlag == 0x080C9574, "SetGameFlag moved")
    ASSERT(ReadSaveByte == 0x80c95a8, "ReadSaveByte moved")
    ASSERT(WriteSaveByte == 0x80c95c0, "WriteSaveByte moved")
    ASSERT(GetGameFlagFromBuffer == 0x80c95d8, "GetGameFlagFromBuffer moved")
    ASSERT(SetGameFlagInBuffer == 0x80c960c, "SetGameFlagInBuffer moved")
    ASSERT(GetItemProperty == 0x080CA7A4, "GetItemProperty moved")
    ASSERT(AddInventoryItem == 0x080CA900, "AddInventoryItem moved")
    ASSERT(RemoveInventoryItem == 0x080CA9E8, "RemoveInventoryItem moved")
    ASSERT(GetAbilityProperty == 0x080CCD50, "GetAbilityProperty moved")
    ASSERT(SelectUnitAbilityList == 0x080CCE60, "SelectUnitAbilityList moved")
    ASSERT(ApplyItemAbilityFlags == 0x80ccf44, "ApplyItemAbilityFlags moved")
    ASSERT(SetAbilityAvailable == 0x80cd544, "SetAbilityAvailable moved")
    ASSERT(GetAbilityListEntry == 0x80cd480, "GetAbilityListEntry moved")
    ASSERT(ReadAbilitySlotA == 0x80cd498, "ReadAbilitySlotA moved")
    ASSERT(ReadAbilitySlotAValue == 0x80cd4d4, "ReadAbilitySlotAValue moved")
    ASSERT(ReadAbilitySlotB == 0x80cd4ac, "ReadAbilitySlotB moved")
    ASSERT(ReadAbilitySlotBValue == 0x80cd50c, "ReadAbilitySlotBValue moved")
    ASSERT(ReadAbilitySlotC == 0x80cd4c0, "ReadAbilitySlotC moved")
    ASSERT(IsAbilityAvailable == 0x80cd560, "IsAbilityAvailable moved")
    ASSERT(SelectUnitAbilityValue == 0x080CD584, "SelectUnitAbilityValue moved")
    ASSERT(SyncPairedAbilityState == 0x080CD620, "SyncPairedAbilityState moved")
    ASSERT(ClearMatchingAbilitySlot == 0x080CD654, "ClearMatchingAbilitySlot moved")
    ASSERT(FindEmptyUnitPoolASlot == 0x080C83A4, "FindEmptyUnitPoolASlot moved")
    ASSERT(UnitMatchesJobMappingSet == 0x080C841C, "UnitMatchesJobMappingSet moved")
    ASSERT(HasMasteredJobAbilities == 0x80cd2c4, "HasMasteredJobAbilities moved")
    ASSERT(EnableJobFlagForAbility == 0x80cd364, "EnableJobFlagForAbility moved")
    ASSERT(GetJobAbilityList == 0x80cd428, "GetJobAbilityList moved")
    ASSERT(gItemAbilitySets == 0x08520080, "gItemAbilitySets moved")
    ASSERT(gItems == 0x0851D180, "gItems moved")
    ASSERT(UnitHasBlockingState == 0x80cd6a8, "UnitHasBlockingState moved")
    ASSERT(ClearUnitStateUnlessExcluded == 0x80cd70c, "ClearUnitStateUnlessExcluded moved")
    ASSERT(SetOpposingStateCounters == 0x80cd774, "SetOpposingStateCounters moved")
    ASSERT(TickOpposingStateCounters == 0x80cd7f0, "TickOpposingStateCounters moved")
    ASSERT(SetIndexedUnitState == 0x80cd884, "SetIndexedUnitState moved")
    ASSERT(UnitStateE8Bit1 == 0x80cd8b4, "UnitStateE8Bit1 moved")
    ASSERT(UnitStateE8Bit2 == 0x80cd8cc, "UnitStateE8Bit2 moved")
    ASSERT(UnitStateE8Bit3 == 0x80cd8e4, "UnitStateE8Bit3 moved")
    ASSERT(UnitStateE8Bit4 == 0x80cd8fc, "UnitStateE8Bit4 moved")
    ASSERT(UnitStateE8Bit5 == 0x80cd914, "UnitStateE8Bit5 moved")
    ASSERT(UnitStateE8Bit6 == 0x80cd92c, "UnitStateE8Bit6 moved")
    ASSERT(UnitStateE8Bit7 == 0x80cd944, "UnitStateE8Bit7 moved")
    ASSERT(UnitStateE9Bit0 == 0x80cd95c, "UnitStateE9Bit0 moved")
    ASSERT(UnitStateE9Bit1 == 0x80cd974, "UnitStateE9Bit1 moved")
    ASSERT(UnitStateE9Bit2 == 0x80cd98c, "UnitStateE9Bit2 moved")
    ASSERT(UnitStateE9Bit3 == 0x80cd9a4, "UnitStateE9Bit3 moved")
    ASSERT(UnitStateE9Bit4 == 0x80cd9bc, "UnitStateE9Bit4 moved")
    ASSERT(UnitStateE9Bit5 == 0x80cd9d4, "UnitStateE9Bit5 moved")
    ASSERT(UnitStateE9Bit6 == 0x80cd9ec, "UnitStateE9Bit6 moved")
    ASSERT(UnitStateE9Bit7 == 0x80cda04, "UnitStateE9Bit7 moved")
    ASSERT(UnitStateEABit0 == 0x80cda1c, "UnitStateEABit0 moved")
    ASSERT(UnitStateECBit2 == 0x80cda34, "UnitStateECBit2 moved")
    ASSERT(UnitStateECBit1 == 0x80cda4c, "UnitStateECBit1 moved")
    ASSERT(UnitStateEABit1 == 0x80cda64, "UnitStateEABit1 moved")
    ASSERT(UnitStateEABit2 == 0x80cda7c, "UnitStateEABit2 moved")
    ASSERT(UnitStateEABit4 == 0x80cda94, "UnitStateEABit4 moved")
    ASSERT(UnitStateEABit5 == 0x80cdaac, "UnitStateEABit5 moved")
    ASSERT(UnitStateEABit6 == 0x80cdac4, "UnitStateEABit6 moved")
    ASSERT(UnitStateEABit7 == 0x80cdadc, "UnitStateEABit7 moved")
    ASSERT(UnitStateEBBit0 == 0x80cdaf4, "UnitStateEBBit0 moved")
    ASSERT(UnitStateEBBit1 == 0x80cdb0c, "UnitStateEBBit1 moved")
    ASSERT(UnitStateEBBit2 == 0x80cdb24, "UnitStateEBBit2 moved")
    ASSERT(UnitStateEBBit3 == 0x80cdb3c, "UnitStateEBBit3 moved")
    ASSERT(UnitStateEBBit4 == 0x80cdb54, "UnitStateEBBit4 moved")
    ASSERT(UnitStateEBBit5 == 0x80cdb6c, "UnitStateEBBit5 moved")
    ASSERT(UnitStateEBBit6 == 0x80cdb84, "UnitStateEBBit6 moved")
    ASSERT(UnitStateEBBit7 == 0x80cdb9c, "UnitStateEBBit7 moved")
    ASSERT(UnitStateECBit0 == 0x80cdbb4, "UnitStateECBit0 moved")
    ASSERT(UnitStateEABit3 == 0x80cdbcc, "UnitStateEABit3 moved")
    ASSERT(UnitStateECBit3 == 0x80cdbe4, "UnitStateECBit3 moved")
    ASSERT(UnitStateECBit4 == 0x80cdbfc, "UnitStateECBit4 moved")
    ASSERT(UnitStateECBit5 == 0x80cdc14, "UnitStateECBit5 moved")
    ASSERT(UnitStateECBit6 == 0x80cdc2c, "UnitStateECBit6 moved")
    ASSERT(UnitStateECBit7 == 0x80cdc44, "UnitStateECBit7 moved")
    ASSERT(UnitStateEDBit0 == 0x80cdc5c, "UnitStateEDBit0 moved")
    ASSERT(UnitStateEDBit1 == 0x80cdc74, "UnitStateEDBit1 moved")
    ASSERT(UnitStateEDBit2 == 0x80cdc8c, "UnitStateEDBit2 moved")
    ASSERT(UnitStateEDBit3 == 0x80cdca4, "UnitStateEDBit3 moved")
    ASSERT(UnitStateEDBit4 == 0x80cdcbc, "UnitStateEDBit4 moved")
    ASSERT(UnitStateEDBit5 == 0x80cdcd4, "UnitStateEDBit5 moved")
    ASSERT(UnitStateEDBit6 == 0x80cdcec, "UnitStateEDBit6 moved")
    ASSERT(UnitStateEDBit7 == 0x80cdd04, "UnitStateEDBit7 moved")
    ASSERT(SetUnitStateE8Bit1 == 0x80cdd1c, "SetUnitStateE8Bit1 moved")
    ASSERT(SetUnitStateE8Bit2 == 0x80cdd40, "SetUnitStateE8Bit2 moved")
    ASSERT(SetUnitStateE8Bit3 == 0x80cdd64, "SetUnitStateE8Bit3 moved")
    ASSERT(SetUnitStateE8Bit4 == 0x80cdd88, "SetUnitStateE8Bit4 moved")
    ASSERT(SetUnitStateE8Bit5 == 0x80cddac, "SetUnitStateE8Bit5 moved")
    ASSERT(SetUnitStateE8Bit6 == 0x80cddd0, "SetUnitStateE8Bit6 moved")
    ASSERT(SetUnitStateE8Bit7 == 0x80cddf4, "SetUnitStateE8Bit7 moved")
    ASSERT(SetUnitStateE9Bit0 == 0x80cde14, "SetUnitStateE9Bit0 moved")
    ASSERT(SetUnitStateE9Bit1 == 0x80cde38, "SetUnitStateE9Bit1 moved")
    ASSERT(SetUnitStateE9Bit2 == 0x80cde5c, "SetUnitStateE9Bit2 moved")
    ASSERT(SetUnitStateE9Bit3 == 0x80cde80, "SetUnitStateE9Bit3 moved")
    ASSERT(SetUnitStateE9Bit4 == 0x80cdea4, "SetUnitStateE9Bit4 moved")
    ASSERT(SetUnitStateE9Bit5 == 0x80cdec8, "SetUnitStateE9Bit5 moved")
    ASSERT(SetUnitStateE9Bit6 == 0x80cdeec, "SetUnitStateE9Bit6 moved")
    ASSERT(SetUnitStateE9Bit7 == 0x80cdf10, "SetUnitStateE9Bit7 moved")
    ASSERT(SetUnitStateEABit0 == 0x80cdf30, "SetUnitStateEABit0 moved")
    ASSERT(SetUnitStateECBit2 == 0x80cdf54, "SetUnitStateECBit2 moved")
    ASSERT(SetUnitStateECBit1 == 0x80cdf78, "SetUnitStateECBit1 moved")
    ASSERT(SetUnitStateEABit1 == 0x80cdf9c, "SetUnitStateEABit1 moved")
    ASSERT(SetUnitStateEABit2 == 0x80cdfc0, "SetUnitStateEABit2 moved")
    ASSERT(SetUnitStateEABit4 == 0x80cdfe4, "SetUnitStateEABit4 moved")
    ASSERT(SetUnitStateEABit5 == 0x80ce008, "SetUnitStateEABit5 moved")
    ASSERT(SetUnitStateEABit6 == 0x80ce02c, "SetUnitStateEABit6 moved")
    ASSERT(SetUnitStateEABit7 == 0x80ce050, "SetUnitStateEABit7 moved")
    ASSERT(SetUnitStateEBBit0 == 0x80ce070, "SetUnitStateEBBit0 moved")
    ASSERT(SetUnitStateEBBit1 == 0x80ce094, "SetUnitStateEBBit1 moved")
    ASSERT(SetUnitStateEBBit2 == 0x80ce0b8, "SetUnitStateEBBit2 moved")
    ASSERT(SetUnitStateEBBit3 == 0x80ce0dc, "SetUnitStateEBBit3 moved")
    ASSERT(SetUnitStateEBBit4 == 0x80ce100, "SetUnitStateEBBit4 moved")
    ASSERT(SetUnitStateEBBit5 == 0x80ce124, "SetUnitStateEBBit5 moved")
    ASSERT(SetUnitStateEBBit6 == 0x80ce148, "SetUnitStateEBBit6 moved")
    ASSERT(SetUnitStateEBBit7 == 0x80ce16c, "SetUnitStateEBBit7 moved")
    ASSERT(SetUnitStateECBit0 == 0x80ce18c, "SetUnitStateECBit0 moved")
    ASSERT(SetUnitStateEABit3 == 0x80ce1b0, "SetUnitStateEABit3 moved")
    ASSERT(SetUnitStateECBit3 == 0x80ce1d4, "SetUnitStateECBit3 moved")
    ASSERT(SetUnitStateECBit4 == 0x80ce1f8, "SetUnitStateECBit4 moved")
    ASSERT(SetUnitStateECBit5 == 0x80ce21c, "SetUnitStateECBit5 moved")
    ASSERT(SetUnitStateECBit6 == 0x80ce240, "SetUnitStateECBit6 moved")
    ASSERT(SetUnitStateECBit7 == 0x80ce264, "SetUnitStateECBit7 moved")
    ASSERT(SetUnitStateEDBit0 == 0x80ce284, "SetUnitStateEDBit0 moved")
    ASSERT(SetUnitStateEDBit1 == 0x80ce2a8, "SetUnitStateEDBit1 moved")
    ASSERT(SetUnitStateEDBit2 == 0x80ce2cc, "SetUnitStateEDBit2 moved")
    ASSERT(SetUnitStateEDBit3 == 0x80ce2f0, "SetUnitStateEDBit3 moved")
    ASSERT(SetUnitStateEDBit4 == 0x80ce314, "SetUnitStateEDBit4 moved")
    ASSERT(SetUnitStateEDBit5 == 0x80ce338, "SetUnitStateEDBit5 moved")
    ASSERT(SetUnitStateEDBit6 == 0x80ce35c, "SetUnitStateEDBit6 moved")
    ASSERT(SetUnitStateEDBit7 == 0x80ce380, "SetUnitStateEDBit7 moved")
    ASSERT(ReadUnitCounterD8 == 0x80ce3a0, "ReadUnitCounterD8 moved")
    ASSERT(ReadUnitCounterD9 == 0x80ce3a8, "ReadUnitCounterD9 moved")
    ASSERT(ReadUnitCounterDA == 0x80ce3b0, "ReadUnitCounterDA moved")
    ASSERT(ReadUnitCounterDB == 0x80ce3b8, "ReadUnitCounterDB moved")
    ASSERT(ReadUnitCounterDC == 0x80ce3c0, "ReadUnitCounterDC moved")
    ASSERT(ReadUnitCounterDD == 0x80ce3c8, "ReadUnitCounterDD moved")
    ASSERT(ReadUnitCounterDE == 0x80ce3d0, "ReadUnitCounterDE moved")
    ASSERT(ReadUnitCounterDF == 0x80ce3d8, "ReadUnitCounterDF moved")
    ASSERT(ReadUnitCounterE0 == 0x80ce3e0, "ReadUnitCounterE0 moved")
    ASSERT(ReadUnitCounterE1 == 0x80ce3e8, "ReadUnitCounterE1 moved")
    ASSERT(ReadUnitCounterE2 == 0x80ce3f0, "ReadUnitCounterE2 moved")
    ASSERT(ReadUnitCounterE3 == 0x80ce3f8, "ReadUnitCounterE3 moved")
    ASSERT(ReadUnitCounterE4 == 0x80ce400, "ReadUnitCounterE4 moved")
    ASSERT(ReadUnitCounterE5 == 0x80ce408, "ReadUnitCounterE5 moved")
    ASSERT(ReadUnitCounterE6 == 0x80ce410, "ReadUnitCounterE6 moved")
    ASSERT(WriteUnitCounterD8 == 0x80ce418, "WriteUnitCounterD8 moved")
    ASSERT(WriteUnitCounterD9 == 0x80ce420, "WriteUnitCounterD9 moved")
    ASSERT(WriteUnitCounterDA == 0x80ce428, "WriteUnitCounterDA moved")
    ASSERT(WriteUnitCounterDB == 0x80ce430, "WriteUnitCounterDB moved")
    ASSERT(WriteUnitCounterDC == 0x80ce438, "WriteUnitCounterDC moved")
    ASSERT(WriteUnitCounterDD == 0x80ce440, "WriteUnitCounterDD moved")
    ASSERT(WriteUnitCounterDE == 0x80ce448, "WriteUnitCounterDE moved")
    ASSERT(WriteUnitCounterDF == 0x80ce450, "WriteUnitCounterDF moved")
    ASSERT(WriteUnitCounterE0 == 0x80ce458, "WriteUnitCounterE0 moved")
    ASSERT(WriteUnitCounterE1 == 0x80ce460, "WriteUnitCounterE1 moved")
    ASSERT(WriteUnitCounterE2 == 0x80ce468, "WriteUnitCounterE2 moved")
    ASSERT(WriteUnitCounterE3 == 0x80ce470, "WriteUnitCounterE3 moved")
    ASSERT(WriteUnitCounterE4 == 0x80ce478, "WriteUnitCounterE4 moved")
    ASSERT(WriteUnitCounterE5 == 0x80ce480, "WriteUnitCounterE5 moved")
    ASSERT(WriteUnitCounterE6 == 0x80ce488, "WriteUnitCounterE6 moved")
    ASSERT(AddOpposingStateCounter == 0x80ce490, "AddOpposingStateCounter moved")
    ASSERT(gCountedRecordIds == 0x08529EE4, "gCountedRecordIds moved")
    ASSERT(GetRecord70Property == 0x080CE4DC, "GetRecord70Property moved")
    ASSERT(DecodeRecordByte == 0x080CB4A4, "DecodeRecordByte moved")
    ASSERT(GetContentPointer123 == 0x080CB524, "GetContentPointer123 moved")
    ASSERT(AddContentIndex1081 == 0x080CB53C, "AddContentIndex1081 moved")
    ASSERT(ScanEquipmentMask81 == 0x080CB54C, "ScanEquipmentMask81 moved")
    ASSERT(JobAllowsItem == 0x080CB5A8, "JobAllowsItem moved")
    ASSERT(gEquipmentClassMasks == 0x0851D0F4, "gEquipmentClassMasks moved")
    ASSERT(LoadUnitRecordSlot == 0x080CB65C, "LoadUnitRecordSlot moved")
    ASSERT(ReadUnitRecordProperty04 == 0x080CB714, "ReadUnitRecordProperty04 moved")
    ASSERT(ReadUnitRecordProperty05 == 0x080CB750, "ReadUnitRecordProperty05 moved")
    ASSERT(CompareUnsignedBytes == 0x080CB634, "CompareUnsignedBytes moved")
    ASSERT(CompareUnsignedHalfwords == 0x080CB63C, "CompareUnsignedHalfwords moved")
    ASSERT(ItemProperty07Bit1 == 0x080CB644, "ItemProperty07Bit1 moved")
    ASSERT(ReadUnitRecordProperty09 == 0x080CB78C, "ReadUnitRecordProperty09 moved")
    ASSERT(ReadUnitRecordProperty10Or11 == 0x080CB7C0, "ReadUnitRecordProperty10Or11 moved")
    ASSERT(ReadRecordCopySource == 0x080CBB7C, "ReadRecordCopySource moved")
    ASSERT(SetFlag60AtSelectedValues == 0x080CBBC4, "SetFlag60AtSelectedValues moved")
    ASSERT(CalculateItemAmount == 0x080CBC14, "CalculateItemAmount moved")
    ASSERT(ItemAmountAdjustmentApplies == 0x080CC958, "ItemAmountAdjustmentApplies moved")
    ASSERT(GetItemAdjustmentRecord == 0x080CCCF0, "GetItemAdjustmentRecord moved")
    ASSERT(ItemInAdjustmentList == 0x080CC9A0, "ItemInAdjustmentList moved")
    ASSERT(ReadItemAdjustmentEntry == 0x080CC9F0, "ReadItemAdjustmentEntry moved")
    ASSERT(CountCollectionBytes == 0x080CCA54, "CountCollectionBytes moved")
    ASSERT(CountCollectionHalfwords == 0x080CCA80, "CountCollectionHalfwords moved")
    ASSERT(AddCollectionHalfword == 0x080CCAAC, "AddCollectionHalfword moved")
    ASSERT(ReadMappedJob == 0x080CCAD8, "ReadMappedJob moved")
    ASSERT(ReadMappedJobProperty01 == 0x080CCAE8, "ReadMappedJobProperty01 moved")
    ASSERT(ReadMappedJobProperty04 == 0x080CCB08, "ReadMappedJobProperty04 moved")
    ASSERT(ReadMappedJobProperty06 == 0x080CCB28, "ReadMappedJobProperty06 moved")
    ASSERT(ReadMappedJobProperty09 == 0x080CCB48, "ReadMappedJobProperty09 moved")
    ASSERT(ReadMappedJobContentPointer == 0x080CCB68, "ReadMappedJobContentPointer moved")
    ASSERT(HasSaveCollectionRecord == 0x080CCB94, "HasSaveCollectionRecord moved")
    ASSERT(CountSaveCollectionRecords == 0x080CCBC4, "CountSaveCollectionRecords moved")
    ASSERT(IncrementSaveCounterBelow99 == 0x080CCBFC, "IncrementSaveCounterBelow99 moved")
    ASSERT(HasSelectedPoolUnit == 0x080CCC1C, "HasSelectedPoolUnit moved")
    ASSERT(ProcessSelectedPoolUnits == 0x080CCCA0, "ProcessSelectedPoolUnits moved")
    ASSERT(ProcessSelectedPoolUnit == 0x080CC65C, "ProcessSelectedPoolUnit moved")
    ASSERT(SetSelectedPoolUnitState == 0x080CC6F0, "SetSelectedPoolUnitState moved")
    ASSERT(SIZEOF(.text) == 0x1000000, "Matching ROM layout must be exactly 16 MiB")
    /DISCARD/ : { *(*) }
    ASSERT(NextRandom15 == 0x08002804, "NextRandom15 moved")
    ASSERT(SetRandomState == 0x08002824, "SetRandomState moved")
    ASSERT(GetRandomStateAddress == 0x08002830, "GetRandomStateAddress moved")
    ASSERT(CountRandomItemSlots == 0x080CC7CC, "CountRandomItemSlots moved")
    ASSERT(IsItemInRange1To252 == 0x080CB1F4, "IsItemInRange1To252 moved")
    ASSERT(GetInventoryPartition == 0x080CB210, "GetInventoryPartition moved")
    ASSERT(GetInventoryItemClass == 0x080CBD34, "GetInventoryItemClass moved")
    ASSERT(CopyInventoryClass == 0x080CC7F8, "CopyInventoryClass moved")
    ASSERT(FindInventoryItemIndex == 0x080CC86C, "FindInventoryItemIndex moved")
    ASSERT(ClassifyValueByTens == 0x080CC8B4, "ClassifyValueByTens moved")
    ASSERT(GetInventoryQuantityDifference == 0x080CB2B4, "GetInventoryQuantityDifference moved")
    ASSERT(HasInventoryItem == 0x080CB320, "HasInventoryItem moved")
    ASSERT(MapSpecialItemIndex == 0x080CB388, "MapSpecialItemIndex moved")
    ASSERT(UnitItemCategoryAllowed == 0x080CB450, "UnitItemCategoryAllowed moved")
    ASSERT(InspectEquipmentMode0 == 0x080CB48C, "InspectEquipmentMode0 moved")
    ASSERT(InspectEquipment == 0x080CAE2C, "InspectEquipment moved")
}
